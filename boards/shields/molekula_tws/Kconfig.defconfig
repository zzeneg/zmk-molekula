## boards/shields/molekula_tws/Kconfig.defconfig
```kconfig
# Copyright (c) 2020 The ZMK Contributors
# SPDX-License-Identifier: MIT

if SHIELD_MOLEKULA_TWS_LEFT

# Name must be less than 16 characters long!
config ZMK_KEYBOARD_NAME
    default "molekula_tws"

config ZMK_SPLIT_ROLE_CENTRAL
    default y

endif

if SHIELD_MOLEKULA_TWS_LEFT || SHIELD_MOLEKULA_TWS_RIGHT

config ZMK_SPLIT
    default y

endif
```

## boards/shields/molekula_tws/Kconfig.shield
```kconfig
# Copyright (c) 2020 The ZMK Contributors
# SPDX-License-Identifier: MIT

config SHIELD_MOLEKULA_TWS_LEFT
   def_bool $(shields_list_contains,molekula_tws_left)

config SHIELD_MOLEKULA_TWS_RIGHT
   def_bool $(shields_list_contains,molekula_tws_right)
```
