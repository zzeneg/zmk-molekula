## boards/shields/molekula_dongle/Kconfig.shield
```kconfig
# Copyright (c) 2020 The ZMK Contributors
# SPDX-License-Identifier: MIT

config SHIELD_MOLEKULA_DONGLE
   def_bool $(shields_list_contains,molekula_dongle)
```
